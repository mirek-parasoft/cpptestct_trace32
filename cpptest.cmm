;===========================================
; This is a template of a t32 PRACTICE
; script. It uses  following variables:
; CORTEXA32

;===========================================
; initialize and start the debugger

screen.always
RESET
SYStEM.CPU CORTEXA32
SYStEM.Up

;===========================================
; Load the test executable
DATA.LOAD.Elf ".build/goo_test"

;===========================================
; Initialize fdx structures on target/sim 
GO cpptestInitializeStream

;===========================================
; Initialize the FDX communication
FDX.DISable
FDX.METHOD BUFFERE

FDX.OutChannel CoverageSendChannel
FDX.write CoverageSendChannel ".build/cpptest-coverage/CovGoogleTest/CovGoogleTest.clog" 2.
FDX.EnableChannel CoverageSendChannel 

FDX.OutChannel TestsSendChannel
FDX.write TestsSendChannel ".build/gtest_results.xml" 1.
FDX.EnableChannel TestsSendChannel 

;===========================================
; Set breakpoints
B.S _exit

;===========================================
; Run tests
GO


WAIT !run()

;===========================================
; Finalize fdx logging and exit
FDX.CLOSE
QUIT